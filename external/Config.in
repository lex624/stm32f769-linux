## external/Config.in
```kconfig
source "$BR2_EXTERNAL_STM32F769_PATH/package/f769-hello/Config.in"
source "$BR2_EXTERNAL_STM32F769_PATH/package/lcd-shell/Config.in"
```

## external/package/f769-bench/Config.in
```kconfig
config BR2_PACKAGE_F769_BENCH
	bool "F769 wired SSH, BLE and control diagnostics"
	depends on BR2_cortex_m7 && BR2_BINFMT_FLAT
```

## external/package/f769-hello/Config.in
```kconfig
config BR2_PACKAGE_F769_HELLO
	bool "f769-hello"
	help
	  Board bring-up test program for the STM32F769I-DISCO. Prints
	  kernel/board identity and free memory, and demonstrates the
	  noMMU-safe way to spawn a child (vfork + exec, since fork()
	  does not exist on uClinux).
```
